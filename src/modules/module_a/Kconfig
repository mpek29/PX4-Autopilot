## src/modules/module_a/Kconfig
```kconfig
menuconfig MODULES_MODULE_A
	bool "module_a"
	default n
	---help---
		Enable support for module_a
```

## src/modules/module_b/Kconfig
```kconfig
menuconfig MODULES_MODULE_B
	bool "module_b"
	default n
	---help---
		Enable support for module_b
```

## src/modules/my_test_app/Kconfig
```kconfig
menuconfig MODULES_MY_TEST_APP
	bool "my_test_app"
	default n
	---help---
		Enable support for my_test_app
```
